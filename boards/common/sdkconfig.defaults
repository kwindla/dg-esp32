## boards/common/sdkconfig.defaults
```kconfig
# Board-neutral policy from root sdkconfig.defaults; root stays the S3 source.
# scripts/test_check_sdkconfig.py enforces exact key/value coverage and drift.
CONFIG_PARTITION_TABLE_CUSTOM=y
CONFIG_PARTITION_TABLE_CUSTOM_FILENAME="partitions.csv"
CONFIG_PARTITION_TABLE_FILENAME="partitions.csv"
CONFIG_SPIRAM_USE_MALLOC=y
CONFIG_SPIRAM_MALLOC_ALWAYSINTERNAL=1024
CONFIG_COMPILER_CXX_EXCEPTIONS=y
CONFIG_COMPILER_CXX_EXCEPTIONS_EMG_POOL_SIZE=1024
CONFIG_COMPILER_OPTIMIZATION_PERF=y
CONFIG_LOG_DEFAULT_LEVEL_INFO=y
CONFIG_LOG_MAXIMUM_LEVEL_DEBUG=y
CONFIG_PTHREAD_TASK_STACK_SIZE_DEFAULT=8192
CONFIG_PTHREAD_TASK_PRIO_DEFAULT=5
CONFIG_LWIP_TCPIP_TASK_AFFINITY_CPU0=y
CONFIG_FREERTOS_USE_TRACE_FACILITY=y
CONFIG_MBEDTLS_SSL_PROTO_DTLS=y
CONFIG_MBEDTLS_SSL_DTLS_SRTP=y
CONFIG_MBEDTLS_X509_CREATE_C=y
CONFIG_MBEDTLS_EXTERNAL_MEM_ALLOC=y
CONFIG_FREERTOS_TASK_CREATE_ALLOW_EXT_MEM=y
CONFIG_FREERTOS_HZ=1000
CONFIG_HEAP_PLACE_FUNCTION_INTO_FLASH=n
CONFIG_SPIRAM_MALLOC_RESERVE_INTERNAL=16384
CONFIG_DG_PLAYBACK_GAIN_PERCENT=33
CONFIG_FREERTOS_GENERATE_RUN_TIME_STATS=y
CONFIG_FREERTOS_RUN_TIME_STATS_USING_ESP_TIMER=y
CONFIG_DG_PHASE1_DIAGNOSTICS=y
CONFIG_DG_PEER_PEM_PSRAM=n
CONFIG_DG_FAST_MIC_DIAGNOSTICS=y
CONFIG_DG_PLAYBACK_CEILING_PERCENT=26
CONFIG_DG_PLAYBACK_HIGHPASS_HZ=500
CONFIG_DG_PLAYBACK_STACK_BYTES=17152
CONFIG_DG_PLAYOUT_TARGET_FRAMES=7
CONFIG_DG_PLAYOUT_MAX_TARGET_FRAMES=10
CONFIG_RINGBUF_PLACE_ISR_FUNCTIONS_INTO_FLASH=y
CONFIG_DG_PEER_RX_STACK_BYTES=4096
CONFIG_DG_SPEAKER_DIAGNOSTICS=y
CONFIG_DG_PEER_FULL_CALL_TIMING=n
CONFIG_DG_PEER_ARRIVAL_TRACE=n
CONFIG_DG_PEER_DIRECT_SOCKET_SELECT=y
CONFIG_DG_PLAYBACK_NORMALIZE=y
CONFIG_DG_PLAYBACK_TARGET_DBFS=-22
CONFIG_DG_PLAYBACK_MAX_GAIN_DB=18
CONFIG_DG_PLAYBACK_ACTIVITY_DBFS=-45
CONFIG_DG_PLAYBACK_LEVEL_MS=400
CONFIG_DG_PLAYBACK_ATTACK_MS=100
CONFIG_DG_PLAYBACK_RELEASE_MS=1000
CONFIG_DG_PLAYBACK_LOOKAHEAD_MS=2
CONFIG_DG_PLAYBACK_LIMITER_RELEASE_MS=75
CONFIG_DG_PLAYBACK_COMPRESSION_RATIO=3
CONFIG_DG_PLAYBACK_COMPRESSION_THRESHOLD_DBFS=-18
CONFIG_DG_MIC_GAIN_PERCENT=1600
CONFIG_LWIP_STATS=n
CONFIG_LWIP_UDP_RECVMBOX_SIZE=32
CONFIG_DG_PEER_JITTER_TIMEOUT_MS=200
CONFIG_DG_PEER_RECV_TIMEOUT_MS=20
CONFIG_DG_OPUS_UPLINK_FRAME40=n
CONFIG_DG_OPUS_FEC=n
CONFIG_DG_CODEC_EAGER_INITIALIZATION=y
CONFIG_DG_OPUS_ENCODER_HOT_IRAM=n
CONFIG_DG_CODEC_LAYOUT_TRACE=n
CONFIG_DG_PLAYBACK_DSP_IRAM=n
CONFIG_DG_PLAYBACK_BREAKDOWN=n
CONFIG_DG_CACHE_COUNTERS=n
CONFIG_LITTLEFS_READ_SIZE=128
CONFIG_LITTLEFS_WRITE_SIZE=128
CONFIG_LITTLEFS_CACHE_SIZE=128
CONFIG_LITTLEFS_LOOKAHEAD_SIZE=128
CONFIG_LITTLEFS_OBJ_NAME_LEN=80
CONFIG_LITTLEFS_MAX_PARTITIONS=1
CONFIG_LITTLEFS_MALLOC_STRATEGY_SPIRAM=y
```

## components/dg_audio/Kconfig
```kconfig
menu "Board audio"
config DG_MIC_DMA_DESCRIPTORS
    int "Capture DMA descriptors (10 ms each)"
    range 2 6
    default 3
config DG_MIC_DMA_FRAMES
    int "Frames per capture DMA buffer"
    range 80 320
    default 160
config DG_SPEAKER_DMA_DESCRIPTORS
    int "Playback DMA descriptors (15 ms each)"
    range 3 6
    default 4
config DG_SPEAKER_DMA_FRAMES
    int "Frames per playback DMA buffer"
    range 160 320
    default 240
config DG_MIC_GAIN_PERCENT
    int "Microphone gain (percent)"
    range 1 1600
    default 125 if DG_BOARD_ECHOEAR
    default 200
config DG_PLAYBACK_GAIN_PERCENT
    int "Legacy network playback gain (percent)"
    range 1 100
    default 4
    help
        Used only with speech normalization disabled. Normalized playback
        uses its delivered RMS target and an audible threshold of one PCM unit.
config DG_PLAYBACK_NORMALIZE
    bool "Normalize active speech RMS with a look-ahead peak limiter"
    default y
config DG_PLAYBACK_TARGET_DBFS
    int "Active speech target RMS (dBFS)"
    range -40 -12
    default -22
# DG_PLAYBACK_SEED_DBFS_X10 is owned by pipecat_esp_peer/Kconfig.
config DG_PLAYBACK_MAX_GAIN_DB
    int "Maximum speech normalizer gain (dB)"
    range 0 30
    default 18
config DG_PLAYBACK_ACTIVITY_DBFS
    int "Clean-source speech activity threshold (dBFS)"
    range -70 -30
    default -45
config DG_PLAYBACK_LEVEL_MS
    int "Active speech RMS estimator time constant (ms)"
    range 100 2000
    default 400
config DG_PLAYBACK_ATTACK_MS
    int "Speech gain reduction time constant (ms)"
    range 20 500
    default 100
config DG_PLAYBACK_RELEASE_MS
    int "Speech gain increase time constant (ms)"
    range 200 5000
    default 1000
config DG_PLAYBACK_LOOKAHEAD_MS
    int "Peak limiter attack ramp L (ms; delay is 2L)"
    range 1 2
    default 2
config DG_PLAYBACK_LIMITER_RELEASE_MS
    int "Peak limiter release time constant (ms)"
    range 50 100
    default 75
config DG_PLAYBACK_COMPRESSION_RATIO
    int "Light amplitude compression ratio (1 disables)"
    range 1 4
    default 3
config DG_PLAYBACK_COMPRESSION_THRESHOLD_DBFS
    int "Normalized-speech compression threshold (dBFS peak)"
    range -30 0
    default -18
config DG_PLAYBACK_CEILING_PERCENT
    int "Speaker peak limiter ceiling (percent of full scale)"
    range 1 100
    default 26
config DG_PLAYBACK_HIGHPASS_HZ
    int "Playback Butterworth high-pass corner (0 disables)"
    range 0 3000
    default 500
config DG_PLAYBACK_STACK_BYTES
    int "Internal playback/Opus stack bytes"
    range 16384 32768
    default 17408
config DG_FAST_MIC_DIAGNOSTICS
    bool "Use hardware float bands and exact integer microphone power sums"
    default n
config DG_PLAYBACK_BENCH
    bool "Playback self-test and deliberate pause commands (bench only)"
    default n
    help
        Includes the decoder self-test fixtures and deliberate playback pause.
        Leave disabled in production. Does not change audio or VAD settings.

config DG_SPEAKER_DIAGNOSTICS
    bool "Raw pre-gate microphone speaker measurement and runtime DSP staging"
    default y
endmenu
```

## components/dg_diagnostics/Kconfig
```kconfig
menu "Bench diagnostics"
config DG_PHASE1_DIAGNOSTICS
    bool "Phase 1 memory and timing instrumentation"
    default y
config DG_PLAYBACK_BREAKDOWN
    bool "Bench: measure playback decode, PLC, policy and I2S wall time"
    default n
    help
        Additional per-stage counters, shared by the transport consumer and
        playback pipeline. Wall time includes preemption and I2S blocking;
        task runtime remains the CPU measurement. Disabled in production.
config DG_PLAYBACK_DSP_IRAM
    bool "Bench: move playback DSP code and literals into IRAM"
    default n
    help
        Placement experiment. Report internal SRAM cost and qualify before
        adoption. Audio processing, target and ceiling are unchanged.
config DG_CACHE_COUNTERS
    bool "Bench: cache counter instrumentation and console control"
    default n
    help
        Compile cache metrics and expose cache-counters and the PERF field.
        Disabled in production.
endmenu
```

## components/pipecat_esp_peer/Kconfig
```kconfig
menu "ESP peer memory lifecycle"
config DG_REUSE_TRANSPORT_WORKERS
    bool "Allocate transport workers once and reuse their stacks"
    default y if DG_ECHOEAR_AEC
    default n
config DG_PEER_PEM_PSRAM
    bool "Allocate just the two cached PEM arrays in PSRAM"
    default n
config DG_PEER_RX_STACK_PSRAM
    bool "Place the JSON dispatcher stack in PSRAM"
    depends on FREERTOS_TASK_CREATE_ALLOW_EXT_MEM
    default n
config DG_PEER_OWNER_STACK_BYTES
    int "Peer owner stack bytes"
    range 10240 32768
    default 12800
    help
        Peer-loop (owner) task stack. Measured peak use is 6780-7004 bytes on
        both the AEC and the AEC-off images (q1-aec-v87-01, rollback-01), so
        12800 keeps the 4096-byte free-stack floor in both production modes
        (decision 111(a)). The previous AEC-off default of 10752 left about
        3.8 KB free, under that floor.
config DG_PEER_RX_STACK_BYTES
    int "JSON dispatcher stack bytes"
    range 4096 16384
    default 8192
config DG_AUDIO_TX_STACK_BYTES
    int "Opus encoder stack bytes (internal RAM)"
    range 32768 49152 if DG_OPUS_UPLINK_FRAME40
    range 16384 49152 if !DG_OPUS_UPLINK_FRAME40
    default 26624 if DG_ECHOEAR_AEC && !DG_OPUS_UPLINK_FRAME40
    default 28672 if DG_BOARD_ECHOEAR && !DG_OPUS_UPLINK_FRAME40
    # Three P4 sessions: ceil((28672 - 6196 + 4096)/1024)*1024.
    default 26624 if DG_BOARD_P4XC && !DG_OPUS_UPLINK_FRAME40
    default 32768
config DG_AUDIO_TX_CORE
    int "Opus encoder CPU core"
    range 0 1
    # AEC/capture and playback remain on core 1. The AEC live resource trial
    # found encoder starvation there despite adequate average idle time.
    default 0 if DG_ECHOEAR_AEC
    default 1
endmenu

menu "Measured peer performance options"
config DG_PLAYBACK_SEED_DBFS_X10
    int "Effective startup source RMS (tenths of dBFS)"
    range -600 -100
    # Placeholder = EchoEar; re-derive from P4 live playback source.
    default -289 if DG_BOARD_P4XC
    default -289
    help
        -28.9 dBFS is the effective post-compression RMS seed: typical
        -26 dBFS post-HPF Thalia TTS has post-compression source RMS about
        3 dB lower, giving a -28.9 dBFS seed.
        Initial gain is target RMS / seed RMS. Tune for a different voice.

config DG_PEER_LOOP_DELAY_MS
    int "Extra peer-loop delay (0 uses native socket wait)"
    range 0 20
    default 1
config DG_PEER_RECV_TIMEOUT_MS
    int "Native socket wait timeout"
    range 1 100
    default 20
config DG_PEER_JITTER_TIMEOUT_MS
    int "Native RTP jitter cache timeout"
    range 60 300
    default 200
config DG_OPUS_BITRATE
    int "Uplink Opus bitrate"
    range 16000 32000
    default 24000
config DG_OPUS_FEC
    bool "Include uplink Opus in-band FEC"
    default n
    help
        The ASR receiver decodes individual packets without LBRR recovery.
        The qualified ASR uplink defaults to off; enable for a receiver
        that explicitly performs in-band FEC recovery.
config DG_OPUS_UPLINK_FRAME40
    bool "Use 40 ms uplink Opus frames"
    default n
    help
        Combines two 20 ms PCM frames before encoding (10 ms mean additional
        assembly wait). aiortc prefetch=4 adds about 80 ms extra receive
        buffering at this packet duration. Bench VAD-stop shifted 80-93 ms
        and audible reply 61-74 ms. Requires a 32768-byte audio TX stack.
config DG_PEER_DIRECT_SOCKET_SELECT
    bool "Use lwIP directly for peer-only socket descriptor sets"
    default y
config DG_PEER_FULL_CALL_TIMING
    bool "Collect detailed nested peer-call timings"
    default n
    help
        Loop iteration timing, frame timings and task PERF
        remain active when disabled. Enable detailed calls for investigation.
config DG_PEER_ARRIVAL_TRACE
    bool "Record diagnostic packet arrivals and playout events"
    default n
    help
        Enable for dropout attribution; disabled by default to avoid packet
        parsing, timestamps and PSRAM ring writes in normal media paths.
config DG_PEER_OWNER_PRIORITY
    int "Peer-loop task priority"
    range 6 14
    default 6
config DG_CODEC_EAGER_INITIALIZATION
    bool "Prepare codecs before publishing the session"
    default y
    help
        Allocate decoder and encoder in a fixed order before native peer setup
        and worker launch. This makes startup allocation timing deterministic.
config DG_CODEC_LAYOUT_TRACE
    bool "Bench: log native codec allocation addresses at construction"
    default n
    help
        Retain allocation sizes and addresses to diagnose boot-dependent
        PSRAM placement. No memory contents are logged; production is off.
config DG_OPUS_ENCODER_HOT_IRAM
    bool "Place SILK frame encoder and NSQ routines in IRAM"
    default n
    help
        Moves selected prebuilt Opus encoder functions and their literals
        into internal RAM. Remaining codec code stays in flash. The CPU
        benefit was within measurement noise in step 8c2; production is off.
endmenu

menu "Consumer-paced bot playout"
config DG_PLAYOUT_TARGET_FRAMES
    int "Fixed jitter reserve in 20 ms frames"
    range 7 7
    default 7
config DG_PLAYOUT_MAX_TARGET_FRAMES
    int "Contiguous ready backlog cap in 20 ms frames"
    range 10 10
    default 10
endmenu

config DG_PEER_DTLS_RX_TRACE
    bool "Trace DTLS application datagrams at recvfrom (diagnostic only)"
    default n
    help
        Record size, device time and public record identity in the arrival ring.
        Requires runtime arrival-trace; never records encrypted payload or keys.
```
